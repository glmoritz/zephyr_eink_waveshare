## boards/custom/eink_llss_esp32/Kconfig.eink_llss_esp32
```kconfig
config BOARD_EINK_LLSS_ESP32
	select SOC_ESP32S3_WROOM_N16R8
	select SOC_ESP32S3_PROCPU if BOARD_EINK_LLSS_ESP32_ESP32S3_PROCPU
```

## boards/custom/eink_llss_esp32/board.yml
```yaml
board:
  name: eink_llss_esp32
  full_name: E-Ink LLSS ESP32 Board
  vendor: custom
  socs:
  - name: esp32s3
```

## modules/wifi_prov/Kconfig
```kconfig
config WIFI_PROV
config WIFI_PROV
	bool "WiFi provisioning module"
	select WIFI
	select NET_MGMT
	select NET_MGMT_EVENT
	select NET_L2_WIFI_MGMT
	select NET_SOCKETS
	select NET_DHCPV4_SERVER
	select FLASH
	select FLASH_MAP
	select NVS
	help
	  Enables the WiFi provisioning module with captive portal.
```

## modules/wifi_prov_sim/Kconfig
```kconfig
config WIFI_PROV
	bool "WiFi provisioning (native_sim stub)"
	default y
	help
	  Stub provisioning module for native_sim builds. The TAP interface
	  is already configured by NET_CONFIG_AUTO_INIT, so wifi_prov_start()
	  simply announces WIFI_PROV_CONNECTED to the application callback
	  after a short delay.
```
